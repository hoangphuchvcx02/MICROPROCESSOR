/*
SH_CP (74HC595) <-> CLK (kit thí nghi?m)
DS (74HC595) <-> DSI (kit thí nghi?m)
ST_CP (74HC595) <-> LATCH (kit thí nghi?m)
~MR (74HC595) <-> CLR (kit thí nghi?m)

PB2 - LATCH
PB3 - CLR
PB5 - DSI
PB7 - CLK   // c?u hình b?ng sck ph?n c?ng

*/
.EQU SPI_PORT=PORTB         ; ??nh ngh?a c?ng SPI là PORTB
.ORG 00
//.DEF SHIFTDAT= R20
//.EQU CLEARSIGNALPORT = PORTB
//.EQU CLEARSIGNALPIN = 3 
//.EQU SHIFTCLOCKPORT = PORTB 
//.EQU SHIFTCLOCKPIN = 7 
//.EQU LATCHPORT = PORTB 
//.EQU LATCHPIN = 2 
//.EQU SHIFTDATAPORT = PORTB 
//.EQU SHIFTDATAPIN = 5 

		LDI R16,(1<<PB7)|(1<<PB5)|(1<<PB3)|(1<<PB2)
		OUT DDRB,R16
		SBI PORTB,3
		SBI PORTB,4 

		LDI R16,(1<<SPE0)|(1<<MSTR0)|(1<<SPR00)
		OUT SPCR0,R16
		CALL USART_INIT
MAIN: 
		CALL USART_RECEIVECHAR
		CALL USART_SENDCHAR
		MOV R20,R21
		//CBI PORTB,4
		RCALL SPI_TRANS
		//SBI PORTB,4
		SBI PORTB,2
		CBI PORTB,2; LATCH
RJMP MAIN

//////////////////////SMALL FUNCTION//////////////
USART_INIT:
	LDI R16,0X00 
	STS UBRR0H,R16 
	LDI R16,51 ;9600 BAUD RATE
	STS UBRR0L,R16
	LDI R16, (1 << UCSZ01) | (1 << UCSZ00)
	STS UCSR0C, R16
	LDI R16, (1 << RXEN0) | (1 << TXEN0)
	STS UCSR0B, R16
RET


USART_SENDCHAR:
	LDS R17, UCSR0A
	SBRS R17, UDRE0 ;CHECK USART DATA REGISTER EMPTY BIT
	RJMP USART_SENDCHAR
	STS UDR0, R20 ;SEND OUT
 RET

USART_RECEIVECHAR:
	LDS R17, UCSR0A
	SBRS R17, RXC0
	RJMP USART_RECEIVECHAR
	LDS R20, UDR0
	MOV R21,R20
 RET

SPI_TRANS:
	OUT SPDR0,R20 
	WAIT_SPI:
	IN R17,SPSR0
	SBRS R17,SPIF0
	RJMP WAIT_SPI
	IN R18,SPDR0
RET
