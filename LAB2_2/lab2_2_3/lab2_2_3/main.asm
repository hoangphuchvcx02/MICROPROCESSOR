	.ORG 0X0000;
	RJMP RESET_HANDLER;
	.ORG 0X001A;
	RJMP TIMER1_COMP_ISR;

RESET_HANDLER:
	LDI R16, HIGH(RAMEND);
	OUT SPH, R16;
	LDI R16, LOW(RAMEND);
	OUT SPL, R16;
	CALL SHIFTREGISTER_INITPORT;
	CALL SHIFTREGISTER_CLEARDATA;
	CALL INITTIMER1CTC;
	SEI;
	CALL LEDMATRIX_PORTINIT;

MAIN:
	JMP MAIN;
	.EQU CLEARSIGNALPORT = PORTB;
	.EQU CLEARSIGNALPIN = 3;
	.EQU SHIFTCLOCKPORT = PORTB;
	.EQU SHIFTCLOCKPIN = 2;
	.EQU LATCHPORT = PORTB;
	.EQU LATCHPIN = 1;
	.EQU SHIFTDATAPORT = PORTB;
	.EQU SHIFTDATAPIN = 0;


SHIFTREGISTER_INITPORT:
	PUSH R24;
	LDI R24, (1 << CLEARSIGNALPIN) | (1 << SHIFTCLOCKPIN) | (1 << LATCHPIN) | (1 << SHIFTDATAPIN);
	OUT DDRB, R24;
	POP R24;
	RET

SHIFTREGISTER_CLEARDATA:
	CBI CLEARSIGNALPORT, CLEARSIGNALPIN;
	SBI CLEARSIGNALPORT, CLEARSIGNALPIN;
	RET

SHIFTREGISTER_SHIFTOUTDATA:
	PUSH R18;
	CBI SHIFTCLOCKPORT, SHIFTCLOCKPIN;
	LDI R18, 8;

SHIFTLOOP:
	SBRC R27, 7;
	SBI SHIFTDATAPORT, SHIFTDATAPIN;
	SBI SHIFTCLOCKPORT, SHIFTCLOCKPIN;
	LSL R27;
	CBI SHIFTDATAPORT, SHIFTDATAPIN;
	CBI SHIFTCLOCKPORT, SHIFTCLOCKPIN;
	DEC R18;
	BRNE SHIFTLOOP;

	SBI LATCHPORT, LATCHPIN;
	CBI LATCHPORT, LATCHPIN;
	POP R18;
	RET


LEDMATRIX_COL_CONTROL: .DB $80, $40, $20, $10, $08, $04, $02, $01

LEDMATRIX_FONT_A: 
.DB 0b11111100, 0b00010010, 0b00010001, 0b00010001, 0b00010010, 0b11111100, 0b00000000, 0b00000000;

	.EQU LEDMATRIXPORT = PORTD;
	.EQU LEDMATRIXDIR = DDRD;
	.DSEG;

	.ORG SRAM_START
	LEDMATRIXBUFFER: .BYTE 8;
	LEDMATRIXCOLINDEX: .BYTE 1;

	.CSEG;
	.ALIGN 2;

LEDMATRIX_PORTINIT:
	PUSH R20;
	PUSH R21;
	LDI R20, 0b11111111;
	OUT LEDMATRIXDIR, R20;
	LDI R20, 0;
	LDI R31, HIGH(LEDMATRIXCOLINDEX)
	LDI R30, LOW(LEDMATRIXCOLINDEX);
	ST Z, R20;
	LDI R20, 0;
	LDI R31,HIGH(LEDMATRIX_FONT_A << 1);
	LDI R30,LOW(LEDMATRIX_FONT_A << 1);
	LDI R29,HIGH(LEDMATRIXBUFFER);
	LDI R28,HIGH(LEDMATRIXBUFFER);'
	LDI R20,8;

LEDMATRIX_PORTINIT_LOOP:
	LPM R21,Z+;
	ST Y+,R21;
	DEC R20;
	CPI R20,0;
	BRNE LEDMATRIX_PORTINIT_LOOP;
	POP R21;
	POP R20;
	RET

LEDMATRIX_DISPLAY_COL:
	PUSH R16;
	PUSH R27;
	CLR R16;
	OUT LEDMATRIXPORT,R16;
	CALL SHIFTREGISTER_SHIFTOUTDATA;
	LDI R31,HIGH(LEDMATRIX_COL_CONTROL << 1)
	LDI R30,LOW(LEDMATRIX_COL_CONTROL << 1)
	CLR R16;
	ADD R30,R26;
	ADC R31,R16;
	LPM R27,Z;
	OUT LEDMATRIXPORT,R27;
	POP R27;
	POP R16;
	RET
	
INITTIMER1CTC:
	PUSH R16;
	LDI R16,HIGH(12500);
	STS OCR1AH,R16;
	LDI R16,LOW(12500);
	STS OCR1AL,R16;
	LDI R16, (1 << CS10)|(1 << WGM12);
	sts TCCR1B, r16 ; 
	ldi r16, (1 << OCIE1A) ; Load the value 0b00000010 into the temporary register
	sts TIMSK1, r16 ; Enable the timer 1 compare A interrupt
	pop r16
	ret

timer1_COMP_ISR:
	push r16
	push r26
	push r27
	ldi r31,high(LedMatrixColIndex)
	ldi r30,low(LedMatrixColIndex)
	ld r16,z
	mov r26,r16
	ldi r31,high(LedMatrixBuffer)
	ldi r30,low(LedMatrixBuffer)
	add r30,r16
	clr r16
	adc r31,r16
	ld r27,z
	call ledmatrix_display_col
	inc r26
	cpi r26,8
	brne timer1_COMP_ISR_CONT
	ldi r26,0 ;if r26 = 8, reset to 0

timer1_COMP_ISR_CONT:
	ldi r31,high(LedMatrixColIndex)
	ldi r30,low(LedMatrixColIndex)
	st z,r26
	pop r27
	pop r26
	pop r16
	reti
